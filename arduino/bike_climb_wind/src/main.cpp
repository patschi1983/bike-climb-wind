#include <Arduino.h>

#include "MovingAverageFilter.h"

#include <EEPROM.h>
#include <ArduinoJson.h>
#include <WiFi.h>
#include <WifiManager.h>
#include <WebServer.h>
#include <HTTPUpdateServer.h>

#include <BLEDevice.h>
#include <BLEUtils.h>
#include <BLEScan.h>
#include <BLEAdvertisedDevice.h>

#include <SPI.h>
#include <Wire.h>
#include <Adafruit_GFX.h>
#include <Adafruit_SSD1306.h>

//***** CONFIG *****//
const char TITLE[] = "BIKE - Climb & Blow";
const unsigned long CONNECT_TO = 300;  // Timeout for WiFi and MQTT connection attempts in seconds
const unsigned long RECONNECT_TO = 15; // Timeout for WiFi reconnection attempts in seconds
const int CONFIG_SIZE = 5120;          // Configuration size
const char MASKED_PASSWORD[] = "********";

void configRead();
void configSave();
void configClear(bool all);

//***** SETTINGS *****//
int settingsWheelBase = 100;
char settingRiderId[4] = "PAT";
int settingRiderWeight = 78;
String settingBleHeartRateName = "TICKR 53C9";
String settingBleHeartRateAddr = "dd:fb:8d:93:c7:29";
String settingBleFitnessMachineName = "KICKR CORE 33BD";
String settingBleFitnessMachineAddr = "ed:e8:05:37:e1:f2";

bool settingsAreBleDevicesSet();
bool settingsIsBleHeartRateDevSet();
bool settingsIsBleFitnessMachineDevSet();

//***** CALULCATION *****//
int powerMvgAvgLen = 6; // orig = 8;
// 8 = 2 second power average at 4 samples per sec
// 6 = 2 second power average at 3 samples per sec
// 4 = 2 second power average at 2 samples per sec
// 2 = 2 second power average at 1 samples per sec
MovingAverageFilter mafPower(powerMvgAvgLen);
int speedMvgAvgLen = 2; // orig = 2
MovingAverageFilter mafSpeed(speedMvgAvgLen);

// For power and speed declare some variables and set some default values
long calcPrevWheelRevs;     // For speed data set 1
long calcPrevWheelEvntTime; // For speed data set 1
long calcCurrWheelRevs;     // For speed data set 2
long calcCurrWheelEvntTime; // For speed data set 2
int calcSpeedKmh;           // Calculated speed in KM per Hr
int calcPrevSpeedKmh;

//***** DEBUG *****//
bool debugSerialEnabled = false; // Enable serial debug - default value, may be overridden

void debugSetup();
void debugPrintln(String debugText);

//***** ESP *****//
char espFwName[16] = "BikeClimbWind"; // Name of the firmware
char espFwVersion[8] = "0.2";         // Version of the firmware
byte espMac[6];                       // Byte array to store our MAC address

char espNodeName[32] = "BCW";     // Nodes name - default value, may be overridden
char espUniqueNodeName[128] = ""; // Unique node name, generated by combining node name and parts of the mac address
char espConfigUser[32] = "admin"; // User name for web access - default value, may be overridden
char espConfigPassword[32] = "";  // Password for web access - default value, may be overridden

void espNodeSetup();
void espNodeReset();

//***** WIFI *****//
void wifiResetSettings();
void wifiConfig(String wifiSsid, String wifiPass);
void wifiSetup();
void wifiLoop();

//***** WEB *****//
WebServer webServer(80);
HTTPUpdateServer webUpdateServer;

void webSetup();
void webCheckAuth();
void webStartHttpMsg(String type, int code);
void webStartHttpMsg(String type, String meta, int code);
void webStartHttpMsg(String type, String meta, int code, String redirectUrl);
void webSendHttpContent(String content, String find, String replace);
void webSendHttpContent(String content);
void webEndHttpMsg();
void webHandleRoot();
void webHandleSettings();
void webHandleSaveSettings();
void webHandleStatus();
void webHandleNotFound();
void webLoop();

//***** BLE *****//
int bleScanTime = 5; // In seconds
BLEScan *bleScan;

BLEUUID bleServiceHeartRate = BLEUUID((uint16_t)0x180D);
BLEUUID bleCharHeartRate = BLEUUID((uint16_t)0x2A37);
BLEAdvertisedDevice *bleAdvDevHeartRate = nullptr;
BLEClient *bleClntHeartRate = nullptr;
BLERemoteCharacteristic *bleRemoteCharHeartRate = nullptr;
int bleHeartRateBpm = 0;

BLEUUID bleServiceFitnessMachine = BLEUUID((uint16_t)0x1826);
BLEUUID bleCharIndoorBikeData = BLEUUID((uint16_t)0x2AD2);
BLEAdvertisedDevice *bleAdvDevFitnessMachine = nullptr;
BLEClient *bleClntFitnessMachine = nullptr;
BLERemoteCharacteristic *bleRemoteIndoorBikeData = nullptr;
float bleSpeedKmh = 0; // variable for the speed (kmh) read from bluetooth
int blePowerWatt = 0;  // variable for the power (W) read from bluetooth

void bleSetup();
bool bleLoop();
bool bleIsHeartRateConnected();
bool bleConnectHeartRate();
bool bleIsFitnessMachineConnected();
bool bleConnectFitnessMachine();

//***** LIFT *****//
float liftSpeedMpersec = 0;         // for calculation
float liftResistanceWatts = 0;      // for calculation
float liftPowerMinusResistance = 0; // for calculation
double liftTargetGrade = 0;

void liftCalcTargetGrade();

//***** OLED *****//
#define SCREEN_WIDTH 128 // OLED display width, in pixels
#define SCREEN_HEIGHT 64 // OLED display height, in pixels
#define OLED_RESET -1    // Reset pin # (or -1 if sharing Arduino reset pin)
Adafruit_SSD1306 oledDisplay(SCREEN_WIDTH, SCREEN_HEIGHT, &Wire, OLED_RESET);

void oledSetup();
void oledStartDisplay();
void oledWifiDisplay(String ssid);
void oledRefreshDisplay();

void oledPrintTextCenter(String text);
void oledPrintTextRight(String text);
void oledPrintHeartRateLine();
void oledPrintPowerLine();
void oledPrintInclineLine();
void oledPrintInfoLine();

//***** HTML Text - Root *****//
const char HTML_ROOT_SETTINGS[] PROGMEM = "<a href='/settings'><button>Settings</button></a>";
#ifdef BUTTON_MODE
const char HTML_ROOT_BUTTONS[] PROGMEM = "<hr><a href='/buttons'><button>Buttons</button></a>";
#endif
#ifdef RFID_MODE
const char HTML_ROOT_RFID[] PROGMEM = "<hr><a href='/rfid'><button>RFID</button></a>";
#endif
#ifdef MULTI_SENSOR_MODE
const char HTML_ROOT_MULTI[] PROGMEM = "<hr><a href='/multi'><button>Multi Sensor</button></a>";
#endif
const char HTML_ROOT_STATUS[] PROGMEM = "<hr><a href='/status'><button>Status</button></a>";

//***** HTML Text - Setting *****//
const char HTML_SETTINGS_FORM_START[] PROGMEM = "<form method='POST' action='saveSettings'>";
const char HTML_SETTINGS_NODE_NAME[] PROGMEM = "<b>Node Name</b> <i><small>(required. lowercase letters, numbers, and _ only)</small></i><input id='nodeName' required name='nodeName' maxlength=31 placeholder='Node Name' pattern='[a-z0-9_]*' value='{nodeName}'>";
const char HTML_SETTINGS_WIFI_SSID[] PROGMEM = "<br/><br/><b>WiFi SSID</b> <i><small>(required)</small></i><input id='wifiSsid' required name='wifiSsid' maxlength=32 placeholder='WiFi SSID' value='{wifiSsid}'>";
const char HTML_SETTINGS_WIFI_PASSWD[] PROGMEM = "<br/><b>WiFi Password</b> <i><small>(optional)</small></i><input id='wifiPass' name='wifiPass' type='password' maxlength=64 placeholder='WiFi Password' value='{wifiPass}'>";
const char HTML_SETTINGS_ADMIN_USER[] PROGMEM = "<br/><br/><b>Admin Username</b> <i><small>(optional)</small></i><input id='configUser' name='configUser' maxlength=31 placeholder='Admin User' value='{configUser}'>";
const char HTML_SETTINGS_ADMIN_PASSWD[] PROGMEM = "<br/><b>Admin Password</b> <i><small>(optional)</small></i><input id='configPassword' name='configPassword' type='password' maxlength=31 placeholder='Admin User Password' value='{configPassword}'>";
const char HTML_SETTINGS_DEBUG_SERIAL[] PROGMEM = "<br/><br/><b>Debug Serial Enabled</b> <i><small>(0/1)</small></i><input id='debugSerialEnabled' name='debugSerialEnabled' type='number' min='0' max='1' value='{debugSerialEnabled}'>";
const char HTML_SETTINGS_DEBUG_REMOTE[] PROGMEM = "<br/><b>Debug Remote Enabled</b><i> <small>(0/1)</small></i><input id='debugRemoteEnabled' name='debugRemoteEnabled' type='number' min='0' max='1' value='{debugRemoteEnabled}'>";
const char HTML_SETTINGS_BTN_SAVE_FORM_END[] PROGMEM = "<br/><br/><button type='submit'>Save</button></form>";
const char HTML_SETTINGS_BTN_BACK[] PROGMEM = "<hr><a href='/'><button>Back</button></a>";

//***** HTML Text - SaveSetting *****//
const char HTML_SAVESETTINGS_START_REDIR_15SEC[] PROGMEM = "<meta http-equiv='refresh' content='15;url={redirectUrl}' />";
const char HTML_SAVESETTINGS_START_REDIR_3SEC[] PROGMEM = "<meta http-equiv='refresh' content='3;url={redirectUrl}' />";
const char HTML_SAVESETTINGS_SAVE_RESTART[] PROGMEM = "<br/>Saving updated configuration values and restarting device ... <a href='{redirectUrl}'>redirect</a>";
const char HTML_SAVESETTINGS_SAVE_NORESTART[] PROGMEM = "<br/>Saving updated configuration values and updating device ... <a href='{redirectUrl}'>redirect</a>";
const char HTML_SAVESETTINGS_NOCHANGE[] PROGMEM = "<br/>No changes found ... redirecting to <a href='{redirectUrl}'>redirecting</a>";
const char HTML_REPLACE_REDIRURL[] PROGMEM = "{redirectUrl}";

//***** HTML Text - Status *****//
const char HTML_STATUS_FW_NAME[] PROGMEM = "<b>FW Name: </b> {firmwareName}";
const char HTML_STATUS_FW_VERSION[] PROGMEM = "<br/><b>FW Name: </b> {firmwareVersion}";
const char HTML_STATUS_FW_FORM[] PROGMEM = "<form method='POST' action='/updateFw' enctype='multipart/form-data'> <hr> <b>FW Upload: </b> <input type='file' accept='.bin,.bin.gz' name='firmware'> <button>Update Firmware</button> </form> <hr>";
const char HTML_STATUS_CPU[] PROGMEM = "<br/><b>CPU Frequency: </b> {cpuFreq} MHz";
const char HTML_STATUS_SKETCH_SIZE[] PROGMEM = "<br/><b>Sketch Size: </b> {sketchSize} bytes";
const char HTML_STATUS_SKETCH_FREESIZE[] PROGMEM = "<br/><b>Free Sketch Space: </b> {freeSketchSize} bytes";
const char HTML_STATUS_HEAP[] PROGMEM = "<br/><b>Heap Free: </b> {freeHeap}";
const char HTML_STATUS_IPADDR[] PROGMEM = "<br/><b>IP Address: </b> {ipAddr}";
const char HTML_STATUS_SIGSTRENGTH[] PROGMEM = "<br/><b>Signal Strength: </b> {sigStrength}";
const char HTML_STATUS_UPTIME[] PROGMEM = "<br/><b>Uptime: </b> {uptime} sec";
const char HTML_STATUS_BTN_BACK[] PROGMEM = "<hr><a href='/'><button>Back</button></a>";

//*****************************************************************************************************************//void setup() {
void setup()
{
    debugSetup();

    configRead();

    espNodeSetup();

    oledSetup();

    wifiSetup();

    webSetup();

    bleSetup();

    oledRefreshDisplay();
}

//*****************************************************************************************************************//
void loop()
{
    wifiLoop();

    webLoop();

    bleLoop();
}

//*****************************************************************************************************************//

//***** CONFIG Functions *****//
void configRead()
{
    // Read saved config.json from SPIFFS
    debugPrintln(F("SPIFFS: mounting SPIFFS"));

    if (SPIFFS.begin(true))
    {
        if (SPIFFS.exists("/config.json"))
        { // File exists, reading and loading
            debugPrintln(F("SPIFFS: reading /config.json"));

            File configFile = SPIFFS.open("/config.json", "r");
            if (configFile)
            {
                size_t configFileSize = configFile.size(); // Allocate a buffer to store contents of the file.
                std::unique_ptr<char[]> buf(new char[configFileSize]);
                configFile.readBytes(buf.get(), configFileSize);

                DynamicJsonDocument configJson(CONFIG_SIZE);
                DeserializationError jsonError = deserializeJson(configJson, buf.get());

                if (jsonError)
                { // Couldn't parse the saved config
                    bool removedJson = SPIFFS.remove("/config.json");

                    debugPrintln(String(F("SPIFFS: [ERROR] Failed to parse /config.json: ")) + String(jsonError.c_str()));

                    if (removedJson)
                    {
                        debugPrintln(String(F("SPIFFS: Removed corrupt file /config.json")));
                    }
                    else
                    {
                        debugPrintln(String(F("SPIFFS: [ERROR] Corrupt file /config.json could not be removed")));
                    }
                }
                else
                {
                    // Read node configuration
                    if (!configJson["nodeName"].isNull())
                    {
                        strcpy(espNodeName, configJson["nodeName"]);
                    }
                    if (!configJson["configUser"].isNull())
                    {
                        strcpy(espConfigUser, configJson["configUser"]);
                    }
                    if (!configJson["configPassword"].isNull())
                    {
                        strcpy(espConfigPassword, configJson["configPassword"]);
                    }

                    // Read Debug configuration
                    if (!configJson["debugSerialEnabled"].isNull())
                    {
                        debugSerialEnabled = configJson["debugSerialEnabled"];
                    }

                    // Print read JSON configuration
                    String configJsonStr;
                    serializeJson(configJson, configJsonStr);

                    debugPrintln(String(F("SPIFFS: parsed json:")) + configJsonStr);
                }
            }
            else
            {
                debugPrintln(F("SPIFFS: [ERROR] File not found /config.json"));
            }
        }
        else
        {
            debugPrintln(F("SPIFFS: [WARNING] /config.json not found, will be created on first config save"));
        }
    }
    else
    {
        debugPrintln(F("SPIFFS: [ERROR] Failed to mount FS"));
    }
}

void configSave()
{ // Save the parameters to config.json
    debugPrintln(F("SPIFFS: Saving config"));
    DynamicJsonDocument jsonConfigValues(CONFIG_SIZE);

    // Save node configuration
    jsonConfigValues["nodeName"] = espNodeName;
    jsonConfigValues["configUser"] = espConfigUser;
    jsonConfigValues["configPassword"] = espConfigPassword;

    // Save Debug configuration
    jsonConfigValues["debugSerialEnabled"] = debugSerialEnabled;

    File configFile = SPIFFS.open("/config.json", "w");
    if (!configFile)
    {
        debugPrintln(F("SPIFFS: Failed to open config file for writing"));
    }
    else
    {
        serializeJson(jsonConfigValues, configFile);
        configFile.close();

        // Print saved JSON configuration
        String configJsonStr;
        serializeJson(jsonConfigValues, configJsonStr);

        debugPrintln(String(F("SPIFFS: saved json:")) + configJsonStr);
    }

    delay(500);
}

void configClear(bool all)
{ // Clear out all local storage
    debugPrintln(F("RESET: Formatting SPIFFS"));

    SPIFFS.format();

    wifiResetSettings();

    EEPROM.begin(512);
    debugPrintln(F("Clearing EEPROM..."));

    for (uint16_t i = 0; i < EEPROM.length(); i++)
    {
        EEPROM.write(i, 0);
    }

    debugPrintln(F("RESET: Rebooting device"));
    espNodeReset();
}

//***** SETTINGS Functions *****//

bool settingsAreBleDevicesSet()
{
    return settingsIsBleHeartRateDevSet() && settingsIsBleFitnessMachineDevSet();
}

bool settingsIsBleHeartRateDevSet()
{
    return (!settingBleHeartRateName.isEmpty() && !settingBleHeartRateAddr.isEmpty());
}

bool settingsIsBleFitnessMachineDevSet()
{
    return (!settingBleFitnessMachineName.isEmpty() && !settingBleFitnessMachineAddr.isEmpty());
}

//***** DEBUG Functions ****//

void debugSetup()
{
    // Setup serial for debug output
    Serial.begin(115200);
    Serial.println();
}

void debugPrintln(String debugText)
{
    if (!debugSerialEnabled)
    {
        // No debug enabled so do nothing
        return;
    }

    if (debugSerialEnabled)
    {
        String debugTimeText = "[+" + String(float(millis()) / 1000, 3) + "s] " + debugText;

        if (debugSerialEnabled)
        {
            Serial.println(debugTimeText);
            Serial.flush();
        }
    }
}

//***** ESP Functions *****//
void espNodeSetup()
{
    WiFi.macAddress(espMac); // Read our MAC address and save it to espMac

    String uniqueName = String(espNodeName) + "-" + String(espMac[4], HEX) + String(espMac[5], HEX);
    strcpy(espUniqueNodeName, uniqueName.c_str());
}

void espNodeReset()
{
    debugPrintln(F("RESET: reset"));

    delay(500);
    ESP.restart();
    delay(5000);
}

//***** WiFi Functions ****//
void wifiResetSettings()
{
    debugPrintln(F("WIFI: Clearing WiFi settings..."));

    WiFiManager wifiManager;
    wifiManager.resetSettings();
}

void wifiConfig(String wifiSsid, String wifiPass)
{
    debugPrintln(String(F("WIFI: Changing to WiFi network")) + wifiSsid + String(F("|")) + wifiPass + String(F("...")));

    WiFi.begin(wifiSsid.c_str(), wifiPass.c_str());

    delay(1000);
}

void wifiAPCallback(WiFiManager *myWiFiManager)
{
    oledWifiDisplay(myWiFiManager->getWiFiHostname());
}

void wifiSetup()
{
    WiFi.setHostname(espUniqueNodeName);

    WiFiManager wifiManager;
    wifiManager.setTitle(TITLE);
    wifiManager.setAPCallback(wifiAPCallback);

    wifiManager.autoConnect(espUniqueNodeName);
}

void wifiLoop()
{
    while ((WiFi.status() != WL_CONNECTED) || (WiFi.localIP().toString() == "0.0.0.0"))
    {
        // Check WiFi is connected and that we have a valid IP, retry until we do.

        if (WiFi.status() == WL_CONNECTED)
        {
            // If we're currently connected, disconnect so we can try again
            WiFi.disconnect();
        }

        wifiSetup();
    }
}

//***** WebServer Functions *****//
void webSetup()
{
    // Connect with http update server
    if ((espConfigPassword[0] != '\0') && (espConfigPassword[0] != '\0'))
    {
        webUpdateServer.setup(&webServer, String(F("/updateFw")), String(espConfigUser), String(espConfigPassword));
    }
    else
    { // or without a password if not
        webUpdateServer.setup(&webServer, String(F("/updateFw")));
    }

    // Setup webserver
    webServer.on("/", webHandleRoot);
    webServer.on("/settings", webHandleSettings);
    webServer.on("/saveSettings", webHandleSaveSettings);
    webServer.on("/status", webHandleStatus);

    webServer.onNotFound(webHandleNotFound);
    webServer.begin();

    debugPrintln(String(F("HTTP: Server started @ http://")) + WiFi.localIP().toString());
}

void webCheckAuth()
{
    if (espConfigPassword[0] != '\0')
    {
        // Request HTTP auth if configPassword is set

        if (!webServer.authenticate(espConfigUser, espConfigPassword))
        {
            return webServer.requestAuthentication();
        }
    }
}

void webStartHttpMsg(String type, int code)
{
    webStartHttpMsg(type, String(F("")), code, String(F("/")));
}

void webStartHttpMsg(String type, String meta, int code)
{
    webStartHttpMsg(type, meta, code, String(F("/")));
}

void webStartHttpMsg(String type, String meta, int code, String redirectUrl)
{
    // check if auth is needed
    webCheckAuth();

    // Prepare for multipart and send first part of html header
    String httpMessage = FPSTR(HTTP_HEAD_START);
    httpMessage.replace(String(F("{v}")), String(espUniqueNodeName));

    webServer.setContentLength(CONTENT_LENGTH_UNKNOWN);
    webServer.send(code, String(F("text/html")), httpMessage);

    // Send script, style and meta
    webSendHttpContent(FPSTR(HTTP_SCRIPT));
    webSendHttpContent(FPSTR(HTTP_STYLE));

    if (meta.length() > 0)
    {
        meta.replace(HTML_REPLACE_REDIRURL, redirectUrl);
        webSendHttpContent(meta);
    }

    // Send end of html header and start of html body
    webSendHttpContent(FPSTR(HTTP_HEAD_END));

    // Send common content header
    webSendHttpContent(String(F("<h1>")));
    webSendHttpContent(String(espUniqueNodeName));
    webSendHttpContent(String(F("</h1>")));

    if (type.length() > 0)
    {
        webSendHttpContent(String(F("<h2>")));
        webSendHttpContent(String(type));
        webSendHttpContent(String(F("</h2>")));
    }
}

void webSendHttpContent(String content, String find, String replace)
{
    content.replace(find, replace);
    webSendHttpContent(content);
}

void webSendHttpContent(String content)
{
    webServer.sendContent(content);
}

void webEndHttpMsg()
{
    // Send end of html body
    webServer.sendContent(FPSTR(HTTP_END));

    webServer.sendContent("");
    webServer.setContentLength(CONTENT_LENGTH_NOT_SET);
}

void webHandleRoot()
{
    debugPrintln(String(F("HTTP: WebHandleRoot called from client: ")) + webServer.client().remoteIP().toString());

    webStartHttpMsg(String(F("Navigation")), 200);

    webSendHttpContent(HTML_ROOT_SETTINGS);

    webSendHttpContent(HTML_ROOT_STATUS);

    webEndHttpMsg();

    debugPrintln(String(F("HTTP: WebHandleRoot page sent.")));
}

void webHandleSettings()
{
    debugPrintln(String(F("HTTP: WebHandleSettings called from client: ")) + webServer.client().remoteIP().toString());

    webStartHttpMsg(String(F("Settings")), 200);

    String httpMessage = "";
    webSendHttpContent(HTML_SETTINGS_FORM_START);

    webSendHttpContent(HTML_SETTINGS_NODE_NAME, String(F("{nodeName}")), espNodeName);

    webSendHttpContent(HTML_SETTINGS_WIFI_SSID, String(F("{wifiSsid}")), String(WiFi.SSID()));
    webSendHttpContent(HTML_SETTINGS_WIFI_PASSWD, String(F("{wifiSsid}")), MASKED_PASSWORD);

    webSendHttpContent(HTML_SETTINGS_ADMIN_USER, String(F("{configUser}")), String(espConfigUser));
    webSendHttpContent(HTML_SETTINGS_ADMIN_PASSWD, String(F("{configPassword}")), (strlen(espConfigPassword) != 0) ? MASKED_PASSWORD : String(F("")));

    webSendHttpContent(HTML_SETTINGS_DEBUG_SERIAL, String(F("{debugSerialEnabled}")), (debugSerialEnabled ? String(F("1")) : String(F("0"))));

    webSendHttpContent(HTML_SETTINGS_BTN_SAVE_FORM_END);
    webSendHttpContent(HTML_SETTINGS_BTN_BACK);

    webEndHttpMsg();

    debugPrintln(String(F("HTTP: WebHandleSettings page sent.")));
}

void webHandleSaveSettings()
{
    debugPrintln(String(F("HTTP: WebHandleSaveSettings called from client: ")) + webServer.client().remoteIP().toString());
    debugPrintln(String(F("HTTP: Checking for changed settings...")));

    bool configShouldSave = false;
    // check if node settings have changed
    if (webServer.arg(String(F("nodeName"))) != String(espNodeName))
    {
        configShouldSave = true;

        String lowerNodeName = webServer.arg(String(F("nodeName")));
        lowerNodeName.toLowerCase();
        lowerNodeName.toCharArray(espNodeName, 32);
    }
    if (webServer.arg(String(F("configUser"))) != String(espConfigUser))
    {
        configShouldSave = true;

        webServer.arg(String(F("configUser"))).toCharArray(espConfigUser, 32);
    }
    if (webServer.arg(String(F("configPassword"))) != String(MASKED_PASSWORD) && webServer.arg(String(F("configPassword"))) != String(espConfigPassword))
    {
        configShouldSave = true;

        webServer.arg(String(F("configPassword"))).toCharArray(espConfigPassword, 32);
    }

    // check if wifi settings have changed
    bool shouldSaveWifi = false;
    char wifiSsid[32] = "";
    char wifiPass[64] = "";
    if (webServer.arg(String(F("wifiSsid"))) != String(WiFi.SSID()))
    {
        shouldSaveWifi = true;

        webServer.arg(String(F("wifiSsid"))).toCharArray(wifiSsid, 32);

        if (webServer.arg(String(F("wifiPass"))) != String(MASKED_PASSWORD))
        {
            webServer.arg(String(F("wifiPass"))).toCharArray(wifiPass, 64);
        }
    }

    // check if debug settings have changed
    if (webServer.arg(String(F("debugSerialEnabled"))) != String(debugSerialEnabled))
    {
        configShouldSave = true;

        debugSerialEnabled = (webServer.arg(String(F("debugSerialEnabled"))).toInt() > 0);
    }

    // Process config or wifi changes
    if (configShouldSave || shouldSaveWifi)
    {
        // Config updated, notify user and trigger write of configurations or wifi settings7
        debugPrintln(String(F("HTTP: Sending /saveSettings page to client connected from: ")) + webServer.client().remoteIP().toString());

        webStartHttpMsg(String(F("")), HTML_SAVESETTINGS_START_REDIR_15SEC, 200, String(F("/")));
        webSendHttpContent(HTML_SAVESETTINGS_SAVE_RESTART, HTML_REPLACE_REDIRURL, String(F("/")));
        webEndHttpMsg();

        if (configShouldSave)
        {
            configSave();
        }

        if (shouldSaveWifi)
        {
            wifiConfig(wifiSsid, wifiPass);
        }

        espNodeReset();
    }
    else
    {
        // No change found, notify user and link back to config page
        debugPrintln(String(F("HTTP: Sending /saveSettings page to client connected from: ")) + webServer.client().remoteIP().toString());

        webStartHttpMsg(String(F("")), HTML_SAVESETTINGS_START_REDIR_3SEC, 200, String(F("/settings")));
        webSendHttpContent(HTML_SAVESETTINGS_NOCHANGE, HTML_REPLACE_REDIRURL, String(F("/settings")));
        webEndHttpMsg();
    }

    debugPrintln(String(F("HTTP: WebHandleSaveSettings page sent.")));
}

void webHandleStatus()
{
    debugPrintln(String(F("HTTP: WebHandleStatus called from client: ")) + webServer.client().remoteIP().toString());

    webStartHttpMsg(String(F("Status")), 200);

    webSendHttpContent(HTML_STATUS_FW_NAME, String(F("{firmwareName}")), String(espFwName));
    webSendHttpContent(HTML_STATUS_FW_VERSION, String(F("{firmwareVersion}")), String(espFwVersion));
    webSendHttpContent(HTML_STATUS_FW_FORM);
    webSendHttpContent(HTML_STATUS_CPU, String(F("{cpuFreq}")), String(ESP.getCpuFreqMHz()));
    webSendHttpContent(HTML_STATUS_SKETCH_SIZE, String(F("{sketchSize}")), String(ESP.getSketchSize()));
    webSendHttpContent(HTML_STATUS_SKETCH_FREESIZE, String(F("{freeSketchSize}")), String(ESP.getFreeSketchSpace()));
    webSendHttpContent(HTML_STATUS_HEAP, String(F("{freeHeap}")), String(ESP.getFreeHeap()));
    webSendHttpContent(HTML_STATUS_IPADDR, String(F("{ipAddr}")), String(WiFi.localIP().toString()));
    webSendHttpContent(HTML_STATUS_SIGSTRENGTH, String(F("{sigStrength}")), String(WiFi.RSSI()));
    unsigned long uptime = (millis() / 1000);
    webSendHttpContent(HTML_STATUS_UPTIME, String(F("{uptime}")), String(uptime));
    webSendHttpContent(HTML_STATUS_BTN_BACK);

    webEndHttpMsg();

    debugPrintln(String(F("HTTP: WebHandleStatus page sent.")));
}

void webHandleNotFound()
{
    debugPrintln(String(F("HTTP: WebHandleNotFound called from client: ")) + webServer.client().remoteIP().toString());

    webStartHttpMsg(String(F("File Not Found\n\n")), 404);
    webSendHttpContent(String(F("URI: ")));
    webSendHttpContent(webServer.uri());
    webSendHttpContent(String(F("\nMethod: ")));
    webSendHttpContent((webServer.method() == HTTP_GET) ? String(F("GET")) : String(F("POST")));
    webSendHttpContent(String(F("\nArguments: ")));
    webSendHttpContent(String(webServer.args()));
    webSendHttpContent(String(F("\n")));

    for (uint8_t i = 0; i < webServer.args(); i++)
    {
        webSendHttpContent(" " + webServer.argName(i) + ": " + webServer.arg(i) + "\n");
    }

    webEndHttpMsg();

    debugPrintln(String(F("HTTP: WebHandleNotFound page sent.")));
}

void webLoop()
{
    webServer.handleClient();
}

//***** BLE Functions *****//
class BleAdvertisedDeviceCallbacks : public BLEAdvertisedDeviceCallbacks
{
    void onResult(BLEAdvertisedDevice advertisedDevice)
    {
        // heart rate monitor found
        if (strcmp(advertisedDevice.getAddress().toString().c_str(), settingBleHeartRateAddr.c_str()) == 0 && bleAdvDevHeartRate == nullptr)
        {
            bleAdvDevHeartRate = new BLEAdvertisedDevice(advertisedDevice);
            debugPrintln(String(F("Advertised device for heart rate monitor: ")) + bleAdvDevHeartRate->toString().c_str());
        }

        // fitness machine found
        if (strcmp(advertisedDevice.getAddress().toString().c_str(), settingBleFitnessMachineAddr.c_str()) == 0 && bleAdvDevFitnessMachine == nullptr)
        {
            bleAdvDevFitnessMachine = new BLEAdvertisedDevice(advertisedDevice);
            debugPrintln(String(F("Advertised device for fitness machine: ")) + bleAdvDevFitnessMachine->toString().c_str());
        }
    }
};

class BleClientCallbacks : public BLEClientCallbacks
{
    void onConnect(BLEClient *bleClient)
    {
    }

    void onDisconnect(BLEClient *bleClient)
    {
        if (bleClient == bleClntHeartRate)
        {
            bleHeartRateBpm = 0;
        }

        if (bleClient == bleClntFitnessMachine)
        {
            blePowerWatt = 0;
        }

        // delete pointer in case of disconnection
        bleClient = nullptr;
    }
};

void bleSetup()
{
    BLEDevice::init("");
    bleScan = BLEDevice::getScan(); // create new scan
    bleScan->setAdvertisedDeviceCallbacks(new BleAdvertisedDeviceCallbacks());
    bleScan->setActiveScan(true); // active scan uses more power, but get results faster
    bleScan->setInterval(100);
    bleScan->setWindow(99); // less or equal setInterval value
}

bool bleLoop()
{
    bool isConnected = (bleConnectHeartRate() && bleConnectFitnessMachine());

    if (!isConnected)
    {
        // scan for devices
        debugPrintln(String(F("Starting BLE Scan for ")) + String(bleScanTime) + String(F("seconds ...")));
        BLEScanResults foundDevices = bleScan->start(bleScanTime, true);
    }
    else
    {
        bleScan->clearResults(); // delete results from BLEScan buffer to release memory
    }

    return isConnected;
}

static void bleHeartRateNotifyCallback(BLERemoteCharacteristic *bleRemoteCharacteristic, uint8_t *data, size_t length, bool isNotify)
{
    bleHeartRateBpm = data[1];
    debugPrintln(String(F("Notification of Heart Rate: ")) + bleHeartRateBpm + String(F("bpm")));

    oledRefreshDisplay();
}

bool bleIsHeartRateConnected()
{
    return (bleClntHeartRate != nullptr && bleClntHeartRate->isConnected());
}

bool bleConnectHeartRate()
{
    if (bleAdvDevHeartRate != nullptr && (bleClntHeartRate == nullptr || !bleClntHeartRate->isConnected()))
    {
        // connect heart rate monitor if address is set
        debugPrintln(String(F("Forming a connection to heart rate monitor... ")) + bleAdvDevHeartRate->toString().c_str());

        bleClntHeartRate = BLEDevice::createClient();
        bleClntHeartRate->setClientCallbacks(new BleClientCallbacks());
        debugPrintln(String(F(" * Created client for connection")));

        if (bleClntHeartRate->connect(bleAdvDevHeartRate))
        { // if you pass BLEAdvertisedDevice instead of address, it will be recognized type of peer device address (public or private)
            debugPrintln(String(F(" * Connected to BLE device (server)")));

            // Obtain a reference to the heart rate service we are after in the remote BLE server.
            BLERemoteService *pRemoteService = bleClntHeartRate->getService(bleServiceHeartRate);
            if (pRemoteService == nullptr)
            {
                debugPrintln(String(F(" * Failed to find our service UUID :  ")) + bleServiceHeartRate.toString().c_str());
                bleClntHeartRate->disconnect();
                return false;
            }
            debugPrintln(" * Found our service...");
            debugPrintln(String(F("   ** ")) + pRemoteService->toString().c_str());

            // Obtain a reference to the heart rate characteristic in the service of the remote BLE server.
            bleRemoteCharHeartRate = pRemoteService->getCharacteristic(bleCharHeartRate);
            if (bleRemoteCharHeartRate == nullptr)
            {
                debugPrintln(String(F(" * Failed to find our characteristic UUID: ")) + bleCharHeartRate.toString().c_str());
                bleClntHeartRate->disconnect();
                return false;
            }
            debugPrintln(" * Found our characteristic");

            // Register the notification callback
            if (bleRemoteCharHeartRate->canNotify())
            {
                bleRemoteCharHeartRate->registerForNotify(bleHeartRateNotifyCallback);
            }
            else
            {
                debugPrintln(String(F(" * The heart rate characteristic cannot notify.")));
                bleClntHeartRate->disconnect();
                return false;
            }
        }
        else
        {
            debugPrintln(String(F(" * Connection to BLE device (server) failed")));
        }
    }

    return (bleClntHeartRate != nullptr && bleClntHeartRate->isConnected());
}

static void bleIndoorBikeDataNotifyCallback(BLERemoteCharacteristic *bleRemoteCharacteristic, uint8_t *data, size_t length, bool isNotify)
{
    // https://developer.huawei.com/consumer/en/doc/development/HMSCore-Guides/ibd-0000001051005923

    debugPrintln(String(F("Indoor Bike Data received [")) + String(length) + String(F("]...")));
    int index = 0;

    // flags of indoor bike data
    uint16_t flags = (uint16_t)((data[index + 1] << 8) | data[index]);
    String flagString = " * Flags =";
    for (int i = 0; i < 16; i++)
    {
        flagString += String(F(" [")) + String(i) + String(F("] ")) + String(bitRead(flags, i));
    }
    debugPrintln(flagString);

    index += 2;
    if ((flags & 0) == 0)
    { // instantaneous speed
        uint16_t value = ((uint16_t)((data[index + 1] << 8) | data[index]));
        bleSpeedKmh = mafSpeed.process((value * 1.0f) / 100.0f);
        debugPrintln(String(F(" * Instantaneous Speed (kmh/avgfilter) = ")) + String(bleSpeedKmh));
        index += 2;
    }
    if ((flags & 2) > 0)
    { // average speed
        //        uint16_t value = ((uint16_t) ((data[index + 1] << 8) | data[index]));
        //        float averageSpeedKmh = (value * 1.0f) / 100.0f;
        //        debugPrintln(String(F(" * Average Speed (kmh) = ")) + String(averageSpeedKmh));
        index += 2;
    }
    if ((flags & 4) > 0)
    { // instantaneous cadence
        uint16_t value = ((uint16_t)((data[index + 1] << 8) | data[index]));
        float instantaneousCadenceRevMin = (value * 1.0f) / 2.0f;
        debugPrintln(String(F(" * Instantaneous Cadence (rev/min) = ")) + String(instantaneousCadenceRevMin));
        index += 2;
    }
    if ((flags & 8) > 0)
    { // average cadence
        //        uint16_t value = ((uint16_t) ((data[index + 1] << 8) | data[index]));
        //        float averageCadenceRevMin = (value * 1.0f) / 2.0f;
        //        debugPrintln(String(F(" * Average Cadence (rev/min) = ")) + String(averageCadenceRevMin));
        index += 2;
    }
    if ((flags & 16) > 0)
    { // total distance
        //        uint32_t distance = ((uint32_t) (data[index + 2] << 16) | (uint32_t) (data[index + 1] << 8) | data[index]);
        //        debugPrintln(String(F(" * Total distance (m) = ")) + String(distance));
        index += 3;
    }
    if ((flags & 32) > 0)
    { // resistance level
        //        int16_t resistance = ((int16_t) ((data[index + 1] << 8) | data[index]));
        //        debugPrintln(String(F(" * Resistance Level = ")) + String(resistance));
        index += 2;
    }
    if ((flags & 64) > 0)
    { // instantaneous power
        int16_t power = ((int16_t)((data[index + 1] << 8) | data[index]));
        blePowerWatt = mafPower.process(power);
        debugPrintln(String(F(" * Instantaneous Power (watt/avgfilter) = ")) + String(blePowerWatt));
        index += 2;
    }

    liftCalcTargetGrade();
    oledRefreshDisplay();
}

bool bleIsFitnessMachineConnected()
{
    return (bleClntFitnessMachine != nullptr && bleClntFitnessMachine->isConnected());
}

bool bleConnectFitnessMachine()
{
    if (bleAdvDevFitnessMachine != nullptr && (bleClntFitnessMachine == nullptr || !bleClntFitnessMachine->isConnected()))
    {
        // connect fitness machine if address is set
        debugPrintln(String(F("Forming a connection to fitness machine... ")) + bleAdvDevFitnessMachine->toString().c_str());

        bleClntFitnessMachine = BLEDevice::createClient();
        bleClntFitnessMachine->setClientCallbacks(new BleClientCallbacks());
        debugPrintln(String(F(" * Created client for connection")));

        if (bleClntFitnessMachine->connect(bleAdvDevFitnessMachine))
        { // if you pass BLEAdvertisedDevice instead of address, it will be recognized type of peer device address (public or private)
            debugPrintln(String(F(" * Connected to BLE device (server)")));

            // Obtain a reference to the fitness machine service we are after in the remote BLE server.
            BLERemoteService *pRemoteService = bleClntFitnessMachine->getService(bleServiceFitnessMachine);
            if (pRemoteService == nullptr)
            {
                debugPrintln(String(F(" * Failed to find our service UUID :  ")) + bleServiceFitnessMachine.toString().c_str());
                bleClntFitnessMachine->disconnect();
                return false;
            }
            debugPrintln(" * Found our service...");
            debugPrintln(String(F("   ** ")) + pRemoteService->toString().c_str());

            for (auto &myPair : *pRemoteService->getCharacteristics())
            {
                debugPrintln(String(F("     ** ")) + myPair.second->toString().c_str());
            }

            // Obtain a reference to the power characteristic in the service of the remote BLE server.
            bleRemoteIndoorBikeData = pRemoteService->getCharacteristic(bleCharIndoorBikeData);
            if (bleRemoteIndoorBikeData == nullptr)
            {
                debugPrintln(String(F(" * Failed to find our power characteristic UUID: ")) + bleCharIndoorBikeData.toString().c_str());
                bleClntFitnessMachine->disconnect();
                return false;
            }
            debugPrintln(" * Found our characteristic for power");

            // Register the notification callback for power
            if (bleRemoteIndoorBikeData->canNotify())
            {
                bleRemoteIndoorBikeData->registerForNotify(bleIndoorBikeDataNotifyCallback);
            }
            else
            {
                debugPrintln(String(F(" * The power characteristic cannot notify.")));
                bleClntFitnessMachine->disconnect();
                return false;
            }
        }
        else
        {
            debugPrintln(String(F(" * Connection to BLE device (server) failed")));
        }
    }

    return (bleClntFitnessMachine != nullptr && bleClntFitnessMachine->isConnected());
}
//***** LIFT Functions *****//
void liftCalcTargetGrade(void)
{
    debugPrintln(String(F("Speed as base kmh = ")) + String(bleSpeedKmh));
    float speed28 = pow(bleSpeedKmh, 2.8); // pow() needed to raise y^x where x is decimal
    debugPrintln(String(F("Speed pow 28 = ")) + String(speed28));
    liftResistanceWatts = (0.0102 * speed28) + 9.428; // calculate power from rolling / wind resistance
    debugPrintln(String(F("Power from rolling / wind resistance = ")) + String(liftResistanceWatts));
    liftPowerMinusResistance = blePowerWatt - liftResistanceWatts; // find power from climbing
    debugPrintln(String(F("Power from climbing = ")) + String(liftPowerMinusResistance));

    liftSpeedMpersec = bleSpeedKmh / 3.6; // find speed in SI units. 1 meter / second (m/s) is equal 3.6 kilometers / hour (km/h)
    if (liftSpeedMpersec == 0)
    {
        liftTargetGrade = 0;
    }
    else
    {
        liftTargetGrade = ((liftPowerMinusResistance / (settingRiderWeight * 9.8)) / liftSpeedMpersec) * 100; // calculate grade of climb in %
    }

    //  // Limit upper and lower grades
    //  if (inputGrade < -10) {
    //    inputGrade = -10;
    //  }
    //  if (inputGrade > 20) {
    //    inputGrade = 20;
    //  }

    debugPrintln(String(F("Calculated target grade = ")) + String(liftTargetGrade));
}

//***** OLED Functions *****//

void oledSetup()
{
    if (oledDisplay.begin(SSD1306_SWITCHCAPVCC, 0x3C))
    {
        oledStartDisplay();
        delayMicroseconds(500);
    }
    else
    {
        debugPrintln(String(F("Display SSD1306 allocation failed")));
    }
}

void oledStartDisplay()
{
    oledDisplay.clearDisplay();
    oledDisplay.setTextSize(2);
    oledDisplay.setTextColor(WHITE);
    oledDisplay.setCursor(0, 0);
    oledPrintTextCenter(String(F("BIKE")));
    int yPos = oledDisplay.getCursorY();
    oledDisplay.setTextSize(1);
    oledDisplay.setCursor(0, 0);
    oledPrintTextRight(String(F("v")) + String(espFwVersion));
    oledDisplay.setCursor(0, yPos);

    oledPrintTextCenter(String(F("CLIMB & BLOW")));
    oledDisplay.println();
    oledPrintTextCenter(String(F("Starting up...")));
    oledDisplay.display();
}

void oledWifiDisplay(String ssid)
{
    oledDisplay.clearDisplay();
    oledDisplay.setTextSize(2);
    oledDisplay.setTextColor(WHITE);
    oledDisplay.setCursor(0, 0);
    oledPrintTextCenter(String(F("BIKE")));
    int yPos = oledDisplay.getCursorY();
    oledDisplay.setTextSize(1);
    oledDisplay.setCursor(0, 0);
    oledPrintTextRight(String(F("v")) + String(espFwVersion));
    oledDisplay.setCursor(0, yPos);

    oledPrintTextCenter(String(F("CLIMB & BLOW")));
    oledDisplay.println();
    oledPrintTextCenter(String(F("Connect to WiFi...")));
    oledDisplay.println();
    oledPrintTextCenter(ssid);
    oledDisplay.display();
}

void oledNoBleDevicesDisplay()
{
    oledDisplay.clearDisplay();
    oledDisplay.setTextSize(2);
    oledDisplay.setTextColor(WHITE);
    oledDisplay.setCursor(0, 0);
    oledPrintTextCenter(String(F("BIKE")));
    int yPos = oledDisplay.getCursorY();
    oledDisplay.setTextSize(1);
    oledDisplay.setCursor(0, 0);
    oledPrintTextRight(String(F("v")) + String(espFwVersion));
    oledDisplay.setCursor(0, yPos);

    oledPrintTextCenter(String(F("CLIMB & BLOW")));
    oledDisplay.println();
    oledPrintTextCenter(String(F("No devices set...")));
    oledPrintTextCenter(String(F("Use web interface for config.")));
    oledDisplay.display();
}

void oledConnectingBleDevicesDisplay()
{
    oledDisplay.clearDisplay();
    oledDisplay.setTextSize(2);
    oledDisplay.setTextColor(WHITE);
    oledDisplay.setCursor(0, 0);
    oledPrintTextCenter(String(F("BIKE")));

    int yPos = oledDisplay.getCursorY();
    oledDisplay.setTextSize(1);
    oledDisplay.setCursor(0, 0);
    oledPrintTextRight(String(F("v")) + String(espFwVersion));
    oledDisplay.setCursor(0, yPos);

    oledPrintTextCenter(String(F("CLIMB & BLOW")));
    oledDisplay.println();
    oledPrintTextCenter(String(F("Connecting devices...")));
    oledDisplay.println();
    oledDisplay.println((bleIsHeartRateConnected() ? String(F(" OK - ")) : String(F(" ?? - "))) + settingBleHeartRateName);
    oledDisplay.println((bleIsFitnessMachineConnected() ? String(F(" OK - ")) : String(F(" ?? - "))) + settingBleFitnessMachineName);
    oledDisplay.display();
}

void oledValuesDisplay()
{
    oledDisplay.clearDisplay();
    oledDisplay.setCursor(0, 0);

    oledDisplay.setTextSize(2);
    oledPrintHeartRateLine();
    oledPrintTextCenter(String(F("BIKE")));

    int yPos = oledDisplay.getCursorY();
    oledDisplay.setTextSize(1);
    oledDisplay.setCursor(0, 0);
    oledPrintTextRight(String(F("v")) + String(espFwVersion));
    oledDisplay.setCursor(0, yPos);

    oledDisplay.setTextSize(2);
    oledPrintPowerLine();
    oledPrintInclineLine();

    oledDisplay.setTextSize(1);
    oledDisplay.println();
    oledPrintInfoLine();

    oledDisplay.display();
}

void oledRefreshDisplay()
{
    if (!settingsAreBleDevicesSet())
    {
        oledNoBleDevicesDisplay();
        return;
    }

    if (!bleIsHeartRateConnected() || !bleIsFitnessMachineConnected())
    {
        oledConnectingBleDevicesDisplay();
        return;
    }

    oledValuesDisplay();
}

void oledPrintTextCenter(String text)
{
    int16_t x1, y1;
    uint16_t w, h;
    oledDisplay.getTextBounds(text, 0, 0, &x1, &y1, &w, &h); // calc width of new string

    int16_t x = oledDisplay.width() / 2;
    int16_t y = oledDisplay.getCursorY();
    oledDisplay.setCursor(x - w / 2, y);
    oledDisplay.println(text);
}

void oledPrintTextRight(String text)
{
    int16_t x1, y1;
    uint16_t w, h;
    oledDisplay.getTextBounds(text, 0, 0, &x1, &y1, &w, &h); // calc width of new string

    int16_t x = oledDisplay.width();
    int16_t y = oledDisplay.getCursorY();
    oledDisplay.setCursor(x - w, y);
    oledDisplay.println(text);
}

void oledPrintHeartRateLine()
{
    char heartChar = (char)0x03;
    String heartRate = String(heartChar) + " ";

    if (bleHeartRateBpm == 0)
    {
        heartRate += String(F("---"));
    }
    else if (bleHeartRateBpm > 0 && bleHeartRateBpm < 10)
    {
        heartRate += String(F("00")) + String(bleHeartRateBpm);
    }
    else if (bleHeartRateBpm >= 10)
    {
        heartRate += String(bleHeartRateBpm);
    }

    oledDisplay.println(heartRate);
}

void oledPrintPowerLine()
{
    String power = "W ";

    if (blePowerWatt == 0)
    {
        power += String(F("---"));
    }
    else if (blePowerWatt > 0 && blePowerWatt < 10)
    {
        power += String(F("00")) + String(blePowerWatt);
    }
    else if (blePowerWatt >= 10)
    {
        power += String(blePowerWatt);
    }

    oledDisplay.println(power);
}

void oledPrintInclineLine()
{
    String incline = "% ";

    char inclineStr[5] = "";
    sprintf(&inclineStr[0], "%.1f", liftTargetGrade);

    incline += String(inclineStr);

    oledDisplay.println(incline);
}

void oledPrintInfoLine()
{
    oledPrintTextRight(String(settingRiderId) + String(F("@")) + String(espUniqueNodeName));
}